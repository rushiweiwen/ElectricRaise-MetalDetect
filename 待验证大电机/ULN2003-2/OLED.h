/*
4线SPI使用说明：
VBT 供内部DC-DC电压，3.3~4.3V，如果使用5V电压，为保险起见串一个100~500欧的电阻
VCC 供内部逻辑电压 1.8~6V   
GND 地

CS  片选管脚
DC  命令数据选择管脚
RES 模块复位管脚 
D0（SCLK） ，时钟脚，由MCU控制
D1（MOSI） ，主输出从输入数据脚，由MCU控制

*/


#define OLCD_SCL_1  P4OUT |= 0x01         //D0  1110 1111
#define OLCD_SCL_0  P4OUT &= ~(0x01)
#define OLCD_SDA_1  P4OUT |= 0x02       //D1
#define OLCD_SDA_0  P4OUT &= ~(0x02)
#define OLCD_RST_1  P4OUT |= 0x04
#define OLCD_RST_0  P4OUT &= ~(0x04)
#define OLCD_DC_1   P4OUT |= 0x08        //DS
#define OLCD_DC_0   P4OUT &= ~(0x08)
#define OLCD_CS_1   P4OUT |= 0x10
#define OLCD_CS_0   P4OUT &= ~(0x10)


#define XLevelL     0x00
#define XLevelH     0x10
#define XLevel      ((XLevelH&0x0F)*16+XLevelL)
#define Max_Column  128
#define Max_Row     64
#define Brightness  0xCF 

#define X_WIDTH 128
#define Y_WIDTH 64



//======================================================
// 128X64I液晶底层驱动[8X16]字体库
// 设计者: powerint
// 描  述: [8X16]西文字符的字模数据 (纵向取模,字节倒序)
// !"#$%&'()*+,-./0123456789:;<=>?@ABCDEFGHIJKLMNOPQRSTUVWXYZ[\]^_`abcdefghijklmnopqrstuvwxyz{|}~
//======================================================
const uint8 F8X16[]=
{
  0x00,0x00,0x00,0x00,0x00,0x00,0x00,0x00,0x00,0x00,0x00,0x00,0x00,0x00,0x00,0x00,// 0
  0x00,0x00,0x00,0xF8,0x00,0x00,0x00,0x00,0x00,0x00,0x00,0x33,0x30,0x00,0x00,0x00,//!1
  0x00,0x10,0x0C,0x06,0x10,0x0C,0x06,0x00,0x00,0x00,0x00,0x00,0x00,0x00,0x00,0x00,//"2
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  0x00,0x06,0x01,0x01,0x02,0x02,0x04,0x04,0x00,0x00,0x00,0x00,0x00,0x00,0x00,0x00,//~94

};


void Dly_ms(uint16 ms)
{
   uint16 ii,jj;
   if (ms<1) ms=1;
   ms = ms*12 ;
   for(ii=0;ii<ms;ii++)
     for(jj=0;jj<1335;jj++);  //16MHz--1ms
     //for(jj=0;jj<4006;jj++);  //48MHz--1ms 
     //for(jj=0;jj<5341;jj++);    //64MHz--1ms  
}

void LCD_WrDat(uint8 data)
{
  uint8 i=8;
  //LCD_CS_0;;
  OLCD_DC_1;
  OLCD_SCL_0;
  //asm("nop");    
  while(i--)
  {
    if(data&0x80){OLCD_SDA_1;}
    else{OLCD_SDA_0;}
    OLCD_SCL_1; 
    asm("nop");;
    //asm("nop");            
    OLCD_SCL_0;;    
    data<<=1;    
  }
   //LCD_CS_1;
}
void LCD_WrCmd(uint8 cmd)
{
  uint8 i=8;    
  //LCD_CS_0;;
  OLCD_DC_0;;
  OLCD_SCL_0;;
  //asm("nop");   
  while(i--)
  {
    if(cmd&0x80){OLCD_SDA_1;}
    else{OLCD_SDA_0;;}
    OLCD_SCL_1;;
    asm("nop");;
    //asm("nop");             
    OLCD_SCL_0;;    
    cmd<<=1;;   
  }     
    //LCD_CS_1;
}
void LCD_Set_Pos(uint8 x, uint8 y)
{ 
  LCD_WrCmd(0xb0+y);
  LCD_WrCmd(((x&0xf0)>>4)|0x10);
  LCD_WrCmd((x&0x0f)|0x01); 
} 
void LCD_Fill(uint8 bmp_data)
{
    uint8 y,x;	
    for(y=0;y<8;y++)
    {
        LCD_WrCmd(0xb0+y);
        LCD_WrCmd(0x01);
        LCD_WrCmd(0x10);
        for(x=0;x<X_WIDTH;x++)
          LCD_WrDat(bmp_data);
    }
}
void LCD_CLS(void)
{
    uint8 y,x;	
    for(y=0;y<8;y++)
    {
        LCD_WrCmd(0xb0+y);
        LCD_WrCmd(0x01);
        LCD_WrCmd(0x10); 
        for(x=0;x<X_WIDTH;x++)
            LCD_WrDat(0);
    }
}
void LCD_DLY_ms(uint16 ms)
{                         
  uint16 a;
  while(ms)
  {
    a=16000;
    while(a--);
    ms--;
  }
  return;
}

void OLED_Init(void)        
{
     P4SEL=0x00;                    //设置IO口为普通I/O模式
     P4DIR = 0xff;                  //设置IO口方向为输出
     P4OUT = 0x0f;                  //初始设置为00
  
     P4OUT |=0x1f; 
      P4OUT &= ~(0x04);    //RST复位
         
    OLCD_SCL_1;
    //LCD_CS_1; //预制SLK和SS为高电平   	
    OLCD_CS_0 ; ///使能信号端，拉低时正常使用
    OLCD_RST_0;
    LCD_DLY_ms(50);
    OLCD_RST_1;

  LCD_WrCmd(0xae);//--turn off oled panel
  LCD_WrCmd(0x00);//---set low column address
  LCD_WrCmd(0x10);//---set high column address
  LCD_WrCmd(0x40);//--set start line address  Set Mapping RAM Display Start Line (0x00~0x3F)
  LCD_WrCmd(0x81);//--set contrast control register
  LCD_WrCmd(0xcf); // Set SEG Output Current Brightness
  LCD_WrCmd(0xa1);//--Set SEG/Column Mapping     0xa0左右反置 0xa1正常
  LCD_WrCmd(0xc8);//Set COM/Row Scan Direction   0xc0上下反置 0xc8正常
  LCD_WrCmd(0xa6);//--set normal display
  LCD_WrCmd(0xa8);//--set multiplex ratio(1 to 64)
  LCD_WrCmd(0x3f);//--1/64 duty
  LCD_WrCmd(0xd3);//-set display offset Shift Mapping RAM Counter (0x00~0x3F)
  LCD_WrCmd(0x00);//-not offset
  LCD_WrCmd(0xd5);//--set display clock divide ratio/oscillator frequency
  LCD_WrCmd(0x80);//--set divide ratio, Set Clock as 100 Frames/Sec
  LCD_WrCmd(0xd9);//--set pre-charge period
  LCD_WrCmd(0xf1);//Set Pre-Charge as 15 Clocks & Discharge as 1 Clock
  LCD_WrCmd(0xda);//--set com pins hardware configuration
  LCD_WrCmd(0x12);
  LCD_WrCmd(0xdb);//--set vcomh
  LCD_WrCmd(0x40);//Set VCOM Deselect Level
  LCD_WrCmd(0x20);//-Set Page Addressing Mode (0x00/0x01/0x02)
  LCD_WrCmd(0x02);//
  LCD_WrCmd(0x8d);//--set Charge Pump enable/disable
  LCD_WrCmd(0x14);//--set(0x10) disable
  LCD_WrCmd(0xa4);// Disable Entire Display On (0xa4/0xa5)
  LCD_WrCmd(0xa6);// Disable Inverse Display On (0xa6/a7) 
  LCD_WrCmd(0xaf);//--turn on oled panel
  LCD_Fill(0x00);  //初始清屏
  LCD_Set_Pos(0,0);  
    
} 
//==============================================================
//函数名： void LCD_PutPixel(u8 x,u8 y)
//功能描述：绘制一个点（x,y）
//参数：真实坐标值(x,y),x的范围0～127，y的范围0～64
//返回：无
//==============================================================
void LCD_PutPixel(uint8 x,uint8 y)
{
    uint8 data1;  //data1当前点的数据 
     
        LCD_Set_Pos(x,y); 
    data1 = 0x01<<(y%8); 	
    LCD_WrCmd(0xb0+(y>>3));
    LCD_WrCmd(((x&0xf0)>>4)|0x10);
    LCD_WrCmd((x&0x0f)|0x00);
    LCD_WrDat(data1); 	 	
}

//==============================================================
//函数名：LCD_P8x16Str(u8 x,u8 y,u8 *p)
//功能描述：写入一组标准ASCII字符串
//参数：显示的位置（x,y），y为页范围0～7，要显示的字符串
//返回：无
//==============================================================  
void LCD_P8x16Str(uint8 x,uint8 y,uint8 ch[])
{
  uint8 c=0,i=0,j=0;
        
  while (ch[j]!='\0')
  {    
    c =ch[j]-32;
    if(x>120){x=0;y++;}
    LCD_Set_Pos(x,y);    
    for(i=0;i<8;i++)     
      LCD_WrDat(F8X16[c*16+i]);
    LCD_Set_Pos(x,y+1);    
    for(i=0;i<8;i++)     
      LCD_WrDat(F8X16[c*16+i+8]);  
    x+=8;
    j++;
  }
}

void LCD_P8x16_char(uint8 x,uint8 y,uint8 data)
{
  uint8 c=0,i=0,j=0,ch[2];
  ch[1]='\0';
  ch[0]= '0'+data%10;      
  while (ch[j]!='\0')
  {    
    c =ch[j]-32;
    if(x>120){x=0;y++;}
    LCD_Set_Pos(x,y);    
    for(i=0;i<8;i++)     
      LCD_WrDat(F8X16[c*16+i]);
    LCD_Set_Pos(x,y+1);    
    for(i=0;i<8;i++)     
      LCD_WrDat(F8X16[c*16+i+8]);  
    x+=8;
    j++;
  }
}


void LCD_P8x16Data(uint8 x,uint8 y,int32 data)
{
    uint8 d[6];
    uint8 c=0,i=0,j=0;
    
    if(data>=0)d[0]='+';
    else {d[0]='-';data=-data;}
    
    d[1]= '0'+data/10000;
    d[2]= '0'+data/1000%10;
    d[3]= '0'+data/100%10;
    d[4]= '0'+data/10%10;
    d[5]= '0'+data%10;
    
    while (d[j]!='\0')
  {    
    c =d[j]-32;
    if(x>120){x=0;y++;}
    LCD_Set_Pos(x,y);    
    for(i=0;i<8;i++)     
      LCD_WrDat(F8X16[c*16+i]);
    LCD_Set_Pos(x,y+1);    
    for(i=0;i<8;i++)     
      LCD_WrDat(F8X16[c*16+i+8]);  
    x+=8;
    j++;
  }
}


void LCD_P8x16Data_u32(uint8 x,uint8 y,uint32 data)
{
    uint8 d[7];
    uint8 c=0,i=0,j=0;
    d[6] = '\0';
//    if(data>=0)d[0]='+';
//    else {d[0]='-';data=-data;}
    d[0]= '0'+data/100000;
    d[1]= '0'+data/10000%10;
    d[2]= '0'+data/1000%10;
    d[3]= '0'+data/100%10;
    d[4]= '0'+data/10%10;
    d[5]= '0'+data%10;
    
    while (d[j]!='\0')
  {    
    c =d[j]-32;
    if(x>120){x=0;y++;}
    LCD_Set_Pos(x,y);    
    for(i=0;i<8;i++)     
      LCD_WrDat(F8X16[c*16+i]);
    LCD_Set_Pos(x,y+1);    
    for(i=0;i<8;i++)     
      LCD_WrDat(F8X16[c*16+i+8]);  
    x+=8;
    j++;
  }
}


//==============================================================
//函数名： void Draw_BMP(u8 x,u8 y)
//功能描述：显示BMP图片128×64
//参数：起始点坐标(x,y),x的范围0～127，y为页的范围0～7
//返回：无
//==============================================================
void Draw_BMP(uint8 x0,uint8 y0,uint8 x1,uint8 y1,uint8 bmp[])
{   
  uint16 ii=0;
  uint8 x,y;
  
  if(y1%8==0) y=y1/8;      
  else y=y1/8+1;
    for(y=y0;y<=y1;y++)
    {
        LCD_Set_Pos(x0,y);				
            for(x=x0;x<x1;x++)
        {      
            LCD_WrDat(bmp[ii++]);	    	
        }
    }
}
   

void lcd_display()
{
  
      LCD_P8x16Str(0,0,"pro:");
      LCD_P8x16Data_u32(32,0,proximtyDataMAX);
    //  LCD_P8x16Data_u32(32,0,a);
      
      LCD_P8x16Str(0,2,"stop:");
      LCD_P8x16_char(40,2,stop_cw);
      
      LCD_P8x16Str(56,2,"x_cw:");
      LCD_P8x16_char(96,2,x_cw);
      
      LCD_P8x16Str(0,4,"y_cw:");
      LCD_P8x16_char(40,4,y_cw);
      
      LCD_P8x16Str(0,6,"speed:");
      LCD_P8x16Data_u32(70,6,num);

}